ASAP2_VERSION 1 71
/begin PROJECT P ""
/begin MODULE ECU ""
/begin MOD_COMMON "" BYTE_ORDER MSB_LAST /end MOD_COMMON
/begin RECORD_LAYOUT RL FNC_VALUES 1 FLOAT32_IEEE ROW_DIR DIRECT /end RECORD_LAYOUT
/begin AXIS_PTS x_speed "" 0x2040 NO_INPUT_QUANTITY RL 0 NO_COMPU_METHOD 3 -1.0E9 1.0E9 /end AXIS_PTS
/begin AXIS_PTS y_temp "" 0x2030 NO_INPUT_QUANTITY RL 0 NO_COMPU_METHOD 4 -1.0E9 1.0E9 /end AXIS_PTS
/begin CHARACTERISTIC eff_map "" MAP 0x2060 RL 0 NO_COMPU_METHOD -1.0E9 1.0E9 MATRIX_DIM 3 4
 /begin AXIS_DESCR COM_AXIS NO_INPUT_QUANTITY NO_COMPU_METHOD 3 -1.0E9 1.0E9 AXIS_PTS_REF x_speed /end AXIS_DESCR
 /begin AXIS_DESCR COM_AXIS NO_INPUT_QUANTITY NO_COMPU_METHOD 4 -1.0E9 1.0E9 AXIS_PTS_REF y_temp /end AXIS_DESCR
/end CHARACTERISTIC
/end MODULE
/end PROJECT

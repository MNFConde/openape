ASAP2_VERSION 1 71
/begin PROJECT OpenAPE ""
/begin MODULE ECU ""
/begin MOD_COMMON "" BYTE_ORDER MSB_FIRST /end MOD_COMMON
/begin RECORD_LAYOUT RL_UWORD FNC_VALUES 1 UWORD ROW_DIR DIRECT /end RECORD_LAYOUT
/begin RECORD_LAYOUT RL_ULONG FNC_VALUES 1 ULONG ROW_DIR DIRECT /end RECORD_LAYOUT
/begin RECORD_LAYOUT RL_FLOAT32_IEEE FNC_VALUES 1 FLOAT32_IEEE ROW_DIR DIRECT /end RECORD_LAYOUT
/begin CHARACTERISTIC cal_axis_x "" VAL_BLK 0x00002040 RL_FLOAT32_IEEE 0 NO_COMPU_METHOD -1000000000 1000000000 MATRIX_DIM 3 /end CHARACTERISTIC
/begin CHARACTERISTIC cal_axis_y "" VAL_BLK 0x00002030 RL_FLOAT32_IEEE 0 NO_COMPU_METHOD -1000000000 1000000000 MATRIX_DIM 4 /end CHARACTERISTIC
/begin MEASUREMENT cal_folded "" FLOAT32_IEEE NO_COMPU_METHOD 1 0.0 -1000000000 1000000000 ECU_ADDRESS 0x00002020 /end MEASUREMENT
/begin MEASUREMENT cal_gains.kp "" FLOAT32_IEEE NO_COMPU_METHOD 1 0.0 -1000000000 1000000000 ECU_ADDRESS 0x00002028 /end MEASUREMENT
/begin MEASUREMENT cal_gains.ki "" FLOAT32_IEEE NO_COMPU_METHOD 1 0.0 -1000000000 1000000000 ECU_ADDRESS 0x0000202C /end MEASUREMENT
/begin CHARACTERISTIC cal_kp "" VALUE 0x00002090 RL_FLOAT32_IEEE 0 NO_COMPU_METHOD -1000000000 1000000000 /end CHARACTERISTIC
/begin CHARACTERISTIC cal_map "" VAL_BLK 0x00002060 RL_FLOAT32_IEEE 0 NO_COMPU_METHOD -1000000000 1000000000 MATRIX_DIM 3 4 /end CHARACTERISTIC
/begin CHARACTERISTIC cal_mode "" VALUE 0x00002024 RL_ULONG 0 NO_COMPU_METHOD -1000000000 1000000000 /end CHARACTERISTIC
/begin MEASUREMENT calib_c.s_private_gain "" FLOAT32_IEEE NO_COMPU_METHOD 1 0.0 -1000000000 1000000000 ECU_ADDRESS 0x00004010 /end MEASUREMENT
/begin MEASUREMENT obs_bits.a "" ULONG NO_COMPU_METHOD 1 0.0 -1000000000 1000000000 ECU_ADDRESS 0x00004038 /end MEASUREMENT
/begin MEASUREMENT obs_bits.b "" ULONG NO_COMPU_METHOD 1 0.0 -1000000000 1000000000 ECU_ADDRESS 0x00004038 /end MEASUREMENT
/begin MEASUREMENT obs_bits.c "" ULONG NO_COMPU_METHOD 1 0.0 -1000000000 1000000000 ECU_ADDRESS 0x00004038 /end MEASUREMENT
/begin MEASUREMENT obs_flags "" UWORD NO_COMPU_METHOD 1 0.0 -1000000000 1000000000 ECU_ADDRESS 0x0000403C /end MEASUREMENT
/begin MEASUREMENT obs_rpm "" FLOAT32_IEEE NO_COMPU_METHOD 1 0.0 -1000000000 1000000000 ECU_ADDRESS 0x00004040 /end MEASUREMENT
/begin MEASUREMENT obs_speed "" FLOAT32_IEEE NO_COMPU_METHOD 1 0.0 -1000000000 1000000000 ECU_ADDRESS 0x00004044 /end MEASUREMENT
/begin MEASUREMENT obs_state.cur "" FLOAT32_IEEE NO_COMPU_METHOD 1 0.0 -1000000000 1000000000 ECU_ADDRESS 0x00004030 /end MEASUREMENT
/begin MEASUREMENT obs_state.ref "" FLOAT32_IEEE NO_COMPU_METHOD 1 0.0 -1000000000 1000000000 ECU_ADDRESS 0x00004034 /end MEASUREMENT
/begin MEASUREMENT other_c.s_private_gain "" FLOAT32_IEEE NO_COMPU_METHOD 1 0.0 -1000000000 1000000000 ECU_ADDRESS 0x00004014 /end MEASUREMENT
/end MODULE
/end PROJECT
